## Kconfig.projbuild
```kconfig
menu "EBLi Configuration"

    config EBLI_FS_ENABLE
        bool "Enable FS"
        default false

    config EBLI_FS_FLASH_DATA_DIR
        string "Data dir used to seed the data partition"
        depends on EBLI_FS_ENABLE
        default "${PROJECT_SOURCE_DIR}/components/EBLi/fs/nodata"

    config EBLI_WIFI_ENABLE
        bool "Enable Wifi"
        depends on EBLI_FS_ENABLE
        default false

    config EBLI_WIFI_PROVISION_POP
        string "Wifi provisioning Proof-of-Possession"
        depends on EBLI_WIFI_ENABLE
        default "abcd1234"
        help
            Auto provisioning Proof-of-Possession

    config EBLI_MQTT_ENABLE
        bool "Enable MQTT"
        depends on EBLI_WIFI_ENABLE
        default false

    config EBLI_MQTT_DEFAULT_BROKER
        string "MQTT default/fall-back Broker - if no config manager or config manager has no value"
        depends on EBLI_MQTT_ENABLE
        default "mqtt://iot.eclipse.org"
    config EBLI_MQTT_DEFAULT_DEVICE_TOPIC
        string "MQTT default/fall-back Device-Topic - if no config manager or config manager has no value"
        depends on EBLI_MQTT_ENABLE
        default "ebli-device"
    config EBLI_MQTT_DEFAULT_GROUP_TOPIC
        string "MQTT default/fall-back Group-Topic - if no config manager or config manager has no value"
        depends on EBLI_MQTT_ENABLE
        default "ebli-device-group"

    config EBLI_TIME_ENABLE
        bool "Enable Time (Timezone config and NTP Time sync)"
        depends on EBLI_WIFI_ENABLE
        default false

    config EBLI_OTA_ENABLE
        bool "Enable OTA"
        depends on EBLI_WIFI_ENABLE
        default false

    config EBLI_CONFIG_MANAGER_ENABLE
        bool "Enable Config-Manager"
        depends on EBLI_FS_ENABLE
        default false

    config EBLI_SENSORS_ENABLED
        bool "Enable the sensors sub-component"
        depends on EBLI_MQTT_ENABLE
        default false

    config EBLI_SENSORS_PUBLISH_DELAY
        int "delay between each sensor read and publish"
        depends on EBLI_SENSORS_ENABLED
        default 15000

    config EBLI_SENSORS_AHT10_ENABLED
        bool "Enable AHT10 sensor"
        depends on EBLI_SENSORS_ENABLED
        default false

    config EBLI_DEBUG
        bool "Set all Log-Levels to maximum"
        default false

endmenu
```

## testapp/sdkconfig.defaults
```kconfig
################################################################################
# EBLi Stuff

CONFIG_EBLI_FS_ENABLE=y
CONFIG_EBLI_WIFI_ENABLE=y
CONFIG_EBLI_MQTT_ENABLE=y
CONFIG_EBLI_MQTT_DEFAULT_BROKER="black-pearl"
CONFIG_EBLI_MQTT_DEFAULT_DEVICE_TOPIC="ebli-testapp"
CONFIG_EBLI_MQTT_DEFAULT_GROUP_TOPIC="ebli-testapp-group"
CONFIG_EBLI_OTA_ENABLE=y
CONFIG_EBLI_CONFIG_MANAGER_ENABLE=y
```
